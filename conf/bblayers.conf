## conf/bblayers.conf
```bitbake
# LAYER_CONF_VERSION is increased each time build/conf/bblayers.conf
# changes incompatibly
LCONF_VERSION = "7"

BBPATH = "${TOPDIR}"
BBFILES ?= ""

BBLAYERS ?= " \
  ${TOPDIR}/openembedded-core/meta \
  ${TOPDIR}/meta-openembedded/meta-networking \
  ${TOPDIR}/meta-openembedded/meta-oe \
  ${TOPDIR}/meta-openembedded/meta-python \
  ${TOPDIR}/meta-openembedded/meta-filesystems \
  ${TOPDIR}/meta-raspberrypi \
  ${TOPDIR}/meta-sunxi \
  ${TOPDIR}/meta-arm/meta-arm \
  ${TOPDIR}/meta-arm/meta-arm-toolchain \
  ${TOPDIR}/meta-ov \
  ${TOPDIR}/meta-rauc \
  ${TOPDIR}/meta-qt6 \
  ${TOPDIR}/meta-virtualization \
  ${TOPDIR}/meta-enroute \
  ${TOPDIR}/meta-clang \
  "
```

## meta-ov/conf/machine/ov-rpi5.conf
```bitbake
#@TYPE: Machine
#@NAME: RaspberryPi 5 Development Board (64bit)
#@DESCRIPTION: Machine configuration for the RaspberryPi 5 in 64 bits mode

MACHINEOVERRIDES =. "raspberrypi5:"

require conf/machine/include/arm/armv8-2a/tune-cortexa76.inc
include conf/machine/include/rpi-base.inc

PREFERRED_PROVIDER_virtual/kernel = "linux-ov-rpi"
PREFERRED_VERSION_linux-ov-rpi ??= "6.12.%"



MACHINE_FEATURES += "pci"
MACHINE_EXTRA_RRECOMMENDS += "\
    linux-firmware-rpidistro-bcm43455 \
    bluez-firmware-rpidistro-bcm4345c0-hcd \
    linux-firmware-rpidistro-bcm43456 \
    bluez-firmware-rpidistro-bcm4345c5-hcd \
"

RPI_KERNEL_DEVICETREE = " \
    broadcom/bcm2712-rpi-5-b.dtb \
    broadcom/bcm2712-rpi-cm5-cm5io.dtb \
    broadcom/bcm2712-rpi-cm5-cm4io.dtb \
    broadcom/bcm2712-rpi-cm5l-cm5io.dtb \
    broadcom/bcm2712-rpi-cm5l-cm4io.dtb \
"

RPI_KERNEL_DEVICETREE_OVERLAYS:append = " \
    overlays/max98357a.dtbo \
    overlays/ov-rpi5-57-lvds.dtbo \
"
KBUILD_DEFCONFIG = "bcm2712_defconfig"
SDIMG_KERNELIMAGE ?= "kernel_2712.img"
SERIAL_CONSOLES ?= "115200;ttyAMA10"

VC4DTBO ?= "vc4-kms-v3d"

#Enable u-boot
#RPI_USE_U_BOOT = "1"
ENABLE_UART = "1"
#Enable otg mode
ENABLE_DWC2_HOST = "1"
#ENABLE_I2C = "1"

# When u-boot is enabled we need to use the "Image" format and the "booti"
# command to load the kernel
KERNEL_IMAGETYPE_UBOOT ?= "Image"
# "zImage" not supported on arm64 and ".gz" images not supported by bootloader yet
KERNEL_IMAGETYPE_DIRECT ?= "Image"
KERNEL_BOOTCMD ?= "booti"

UBOOT_MACHINE = "rpi_arm64_config"

#ov-rpi-sdimg
IMAGE_CLASSES += "sdcard_image-ov-rpi"
IMAGE_FSTYPES = "tar.bz2 ext3 ext4 wic.bz2 wic.bmap"
```
